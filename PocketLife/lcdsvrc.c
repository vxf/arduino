#include <stdlib.h>
#include <avr/io.h>
//#include <inttypes.h>
#include <util/delay.h>
#include <avr/pgmspace.h>

#define SCK_PIN  0b00100000
#define MISO_PIN 0b00010000
#define MOSI_PIN 0b00001000
#define SS_PIN   0b00000100

#define CE_PIN 0b10000000
#define RE_PIN 0b01000000
#define DC_PIN 0b00100000

#define CMD  0
#define DATA DC_PIN

#define LCD_WIDTH   84
#define LCD_HEIGHT  48
#define LCD_HEIGHT8 (LCD_HEIGHT >> 3)

static const unsigned char PROGMEM dickbutt_glcd_bmp[] =
{
0x00, 0x00, 0x00, 0x00, 0x00, 0x00, 0x00, 0x00, 0x00, 0x00, 0x70, 0xD0, 0x10, 0x10, 0x30, 0xE0,
0x00, 0x00, 0x00, 0xF0, 0x00, 0x00, 0x00, 0x00, 0xE0, 0xB0, 0x10, 0x10, 0x10, 0x00, 0x00, 0x00,
0x00, 0xF0, 0xC0, 0xC0, 0x60, 0x20, 0x00, 0x00, 0x00, 0x00, 0x00, 0x00, 0x00, 0x00, 0x00, 0x00,
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0x00, 0x00, 0x01, 0x01, 0x01, 0x3F, 0x01, 0x01, 0x01, 0x00, 0x00, 0x00, 0x00, 0x00, 0x00, 0x00
};

unsigned char buffer1[LCD_WIDTH * LCD_HEIGHT8], buffer2[LCD_WIDTH * LCD_HEIGHT8];

void send(unsigned char type, unsigned char data);
void clean();
void bitmapFull(const char * bmp);
void bitmapSprite(const unsigned char * bmp, unsigned char w, unsigned char h, unsigned char x, unsigned char y);

void send(unsigned char type, unsigned char data)
{
  // send command
	PORTD = CE_PIN | RE_PIN | type;

	PORTD &= ~CE_PIN;
  SPDR = data;
  while(!(SPSR & (1<<SPIF)));
	PORTD |= CE_PIN;
}

void clean()
{
  unsigned short i;

  send(CMD, 0x80);  // 0
  send(CMD, 0x40);  // 0

  for (i = 0; i < LCD_WIDTH * (LCD_HEIGHT/8); i++)
      send(DATA, 0x00);
}

void bitmapFull(const char * bmp)
{
  send(CMD, 0x80);
  send(CMD, 0x40);

  unsigned short i;

  for (i = 0; i < LCD_WIDTH * (LCD_HEIGHT/8); i++)
      send(DATA, bmp[i]);
}

void bitmapSprite(const unsigned char * bmp, unsigned char w, unsigned char h, unsigned char x, unsigned char y)
{
  h = h >> 3;
  y = y >> 3;
  send(CMD, 0x80 | x);
  send(CMD, 0x40 | y);

  unsigned char * p = bmp;
  unsigned short xd, yd;

  for (yd = 0; yd < h; yd++)
  {
    send(CMD, 0x80 | x);
    send(CMD, 0x40 | y++);

    for (xd = 0; xd < w; xd++)
    {
      send(DATA, pgm_read_byte(p++));
    }
  }
}

void runGOF()
{
  unsigned char * old = buffer1, * new = buffer2, * p;
  unsigned short i;
  unsigned char j, xd, yd;
  unsigned char acc, a, b, c, d, e, f, g, h, x, xn;

  // randomize
  p = buffer1;
  for (i = 0; i < LCD_WIDTH * LCD_HEIGHT8; i++)
      *(p++) = (unsigned char)rand();

  p = buffer2;
  for (i = 0; i < LCD_WIDTH * LCD_HEIGHT8; i++)
      *(p++) = (unsigned char)rand();

	while (1){
    // iterate
    for (yd = 0; yd < LCD_HEIGHT8; yd++)
    {
      for (xd = 0; xd < LCD_WIDTH; xd++)
      {
        // current cell
        x = old[(yd * LCD_WIDTH) + xd];

        // neighbours
        a = (yd > 0) ? old[(yd - 1) * LCD_WIDTH + xd] : 0x00;
        a = (x << 1) | ((a & 0x80) >> 7);

        b = (yd < (LCD_HEIGHT8 - 1)) ? old[((yd + 1) * LCD_WIDTH) + xd] : 0x00;
        b = ((b & 0x1) << 7) | (x >> 1);

        c = (xd > 0) ? old[yd * LCD_WIDTH + (xd - 1)] : 0x00;

        e = (yd > 0) ? old[(yd - 1) * LCD_WIDTH + (xd - 1)] : 0x00;
        e = (c << 1) | ((e & 0x80) >> 7);

        g = (yd < (LCD_HEIGHT8 - 1)) ? old[((yd + 1) * LCD_WIDTH) + (xd - 1)] : 0x00;
        g = ((g & 0x1) << 7) | (c >> 1);

        d = (xd < (LCD_WIDTH - 1)) ? old[(yd * LCD_WIDTH) + (xd + 1)] : 0x00;

        f = (yd > 0) ? old[(yd - 1) * LCD_WIDTH + (xd + 1)] : 0x00;
        f = (d << 1) | ((f & 0x80) >> 7);

        h = (yd < (LCD_HEIGHT8 - 1)) ? old[((yd + 1) * LCD_WIDTH) + (xd + 1)] : 0x00;
        h = ((h & 0x1) << 7) | (d >> 1);

        // calculate each bit of next gen
        xn = 0x0;
        for (j = 8; j; j--)
        {
          acc = (a & 0x1) + (b & 0x1) + (c & 0x1) + (d & 0x1) + (e & 0x1) + (f & 0x1) + (g & 0x1) + (h & 0x1);

          xn >>= 1;
          if (acc == 3 || ((x & 0x1) && acc == 2))
              xn |= 0x80;


          a >>= 1; b >>= 1; c >>= 1; d >>= 1, e >>= 1; f >>= 1; g >>= 1; h >>= 1, x >>= 1;  
        }

        new[(yd * LCD_WIDTH) + xd] = xn;
      }
    }

    // draw
    send(CMD, 0x80);
    send(CMD, 0x40);
    p = new;
    for (i = 0; i < LCD_WIDTH * LCD_HEIGHT8; i++)
        send(DATA, *(p++));

    _delay_ms(100);
    // swap buffer
    p = new;
    new = old;
    old = p;
  }
}

int main(void)
{
  // enable SPI
  DDRB = SS_PIN;
  PORTB = SS_PIN;
  SPCR = (1<<SPE)|(1<<MSTR);

  DDRB = SCK_PIN | MOSI_PIN | SS_PIN;
  PORTB = SCK_PIN | MOSI_PIN | SS_PIN;

  // reset LCD
  DDRD = CE_PIN | RE_PIN | DC_PIN;
	PORTD = RE_PIN;
	PORTD = CE_PIN | RE_PIN;
	PORTD = CE_PIN;
  _delay_ms(100);
	PORTD = CE_PIN | RE_PIN;

  send(CMD, 0x21); //Tell LCD extended commands follow
  send(CMD, 0xB0); //Set LCD Vop (Contrast)
  send(CMD, 0x04); //Set Temp coefficent
  send(CMD, 0x13); //LCD bias mode 1:48 (try 0x13)

  send(CMD, 0x20); 
  send(CMD, 0x0C); //Set display control, normal mode.


  clean();

  // bitmapSprite(dickbutt_glcd_bmp, 48, 48, 18, 0);

  runGOF();

  //send(CMD, 0x08);  // display blank
  //send(CMD, 0x0c);  // normal mode (0x0d = inverse mode)
  
  return 0;
}
